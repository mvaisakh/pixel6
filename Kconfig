## Kconfig
```kconfig
config TOUCHSCREEN_TBN
	tristate "Touch Bus Negotiator for Google Pixel"
	depends on (TOUCHSCREEN_FTS || TOUCHSCREEN_SEC_TS)
	help
	  Say Y here if you have a Google Pixel device. This module enables
	  support for kernel touch drivers to coordinate bus access with remote
	  processors (e.g. sensor DSP processor), which is required to enable
	  low power touch gesture detection in processors other than AP.

	  If unsure, say N.

	  To compile this driver as a module, choose M here: the module will be
	  called touch_bus_negotiator.
```

## drivers/edgetpu/Kconfig
```kconfig
menu "EdgeTPU devices"

config EDGETPU_FRAMEWORK
	tristate "EdgeTPU framework"
	depends on X86_64 || ARM64
	select IOMMU_API
	help
	  This framework supports darwinn-2.0 devices.

config ABROLHOS
	tristate "Abrolhos ML accelerator direct host control driver"
	depends on EDGETPU_FRAMEWORK
	help
	  This driver supports the Abrolhos device.  Say Y if you want to
	  include this driver in the kernel.

	  To compile this driver as a module, choose M here.  The module
	  will be called "abrolhos".

config EDGETPU_TELEMETRY_TRACE
	bool "Build EdgeTPU driver with firmware tracing support"
	depends on EDGETPU_FRAMEWORK
	default y
	help
	  Say Y to have the driver handle the tracing events sent from the
	  firmware. Enable this will increase the time for setup, suggest to
	  disable this in production mode to reduce the software overhead.

	  It's fine to have this enabled even the firmware doesn't send tracing
	  events.

endmenu
```

## drivers/google/Kconfig
```kconfig
# Include all driver sources
menuconfig GOOGLE_DRIVERS
    tristate "Google Drivers"

source "drivers/google/amplifiers/audiometrics/Kconfig"
source "drivers/google/amplifiers/cs40l25/Kconfig"
source "drivers/google/bms/Kconfig"
source "drivers/google/display/samsung/Kconfig"
source "drivers/google/edgetpu/drivers/edgetpu/Kconfig"
source "drivers/google/gpu/mali_kbase/Kconfig"
source "drivers/google/gpu/mali_pixel/Kconfig"
source "drivers/google/lwis/Kconfig"
source "drivers/google/nfc/Kconfig"
source "drivers/google/power/reset/Kconfig"
source "drivers/google/touch/common/Kconfig"
source "drivers/google/touch/fts/ftm5/Kconfig"
source "drivers/google/touch/sec_ts/Kconfig"
source "drivers/google/wlan/bcm4389/Kconfig"
source "drivers/google/wlan/bcm43752/Kconfig"
```

## drivers/google/bluetooth/broadcom/Kconfig
```kconfig
config NITROUS
	tristate "Enable Broadcom Nitrous Bluetooth"
	default n
	help
	   Enable Broadcom nitrous bluetooth build
	   support.
```
